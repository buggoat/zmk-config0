## config/west.yml
```yaml
manifest:
  remotes:
    - name: zmkfirmware
      url-base: https://github.com/zmkfirmware
    # dongle_display
    - name: englmaxi
      url-base: https://github.com/englmaxi
    # nice_oled - nice_epaper - dongle_display!view - oled Adapter
    - name: mctechnology17
      url-base: https://github.com/mctechnology17
    # nice!view gem
    - name: buggoat
      url-base: https://github.com/buggoat
  projects:
    - name: zmk
      remote: zmkfirmware
      revision: v0.3.0
      import: app/west.yml
    # dongle_display
    - name: zmk-dongle-display
      remote: englmaxi
      revision: v0.3
    # nice_oled - nice_epaper
    - name: zmk-nice-oled
      remote: mctechnology17
      revision: main
    # dongle_display!view
    - name: zmk-dongle-display-view
      remote: mctechnology17
      revision: main
    # oled Adapter
    - name: zmk-oled-adapter
      remote: mctechnology17
      revision: main
    # nice!view gem
    - name: nice-view-gem
      remote: buggoat
      revision: main
  self:
    path: config
```
